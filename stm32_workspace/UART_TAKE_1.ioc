# file: UART_TAKE_1.ioc
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Mcu.Family=STM32F4
Mcu.Name=STM32F401C(B-C)Ux
Mcu.Package=UFQFPN48
NVIC.PriorityGroup=NVIC_PRIORITYGROUP_4
ProjectManager.HeapSize=0x200
ProjectManager.StackSize=0x400
ProjectManager.TargetToolchain=STM32CubeIDE
RCC.AHBFreq_Value=16000000
RCC.APB1Freq_Value=16000000
RCC.APB2Freq_Value=16000000
RCC.CortexFreq_Value=16000000
RCC.HSE_VALUE=25000000
RCC.HSI_VALUE=16000000
RCC.LSE_VALUE=32768
RCC.SYSCLKFreq_VALUE=16000000
RCC.VCOOutputFreq_Value=192000000
board=custom

// file: Core/Src/main.c
/* USER CODE BEGIN Header */
/**
  ******************************************************************************
  * @file           : main.c
  * @brief          : Main program body
  ******************************************************************************
  * @attention
  *
  * Copyright (c) 2026 STMicroelectronics.
  * All rights reserved.
  *
  * This software is licensed under terms that can be found in the LICENSE file
  * in the root directory of this software component.
  * If no LICENSE file comes with this software, it is provided AS-IS.
  *
  ******************************************************************************
  */
/* USER CODE END Header */
#include "main.h"
#include <stdint.h>

/* USER CODE BEGIN PTD */

void clk(void){
	RCC_AHB1ENR |= (1 << GPIOA_EN);
	RCC_APB2ENR |= (1 << USART1_EN);
}

void gpio(void){
	GPIOA_MODER |= (2<<18) | (2<<20) | (1<<(2*3));
	GPIOA_AFRH  |= (7<<4) | (7<<8);
}

void toggle(void){
	GPIOA_ODR ^= (1<<3);
	for(int i = 0; i < 100; i++);
}

void init(void){
	USART_CR1 |= (1<<UE);
	USART_CR1 |= (0<<M);
	// configure STOP bit (by default it is 1)
	USART_BRR |= 0x00000683; // set baud rate to 9600
	USART_CR1 |= (1<<TE);
	while (((USART_SR >> TXE) & 1) != 1);
	USART_DR = (uint8_t)0x75;
	while (((USART_SR >> TC) & 1) != 1);
}                                                /// This Block Passed The Test

void transmit(uint8_t data){
	toggle();
//	PTR = 0x00;
	USART_CR1 |= (1<<TE);
	while (((USART_SR >> TXE) & 1) != 1);
	USART_DR = data;
	while (((USART_SR >> TC) & 1) != 1);
//	PTR = 0xFF;
	toggle();
}

void UART_TX_REG(uint32_t data){
//	USART_DR = (uint8_t) data;
	toggle();
	USART_CR1 |= (1<<TE);
	while (((USART_SR >> TXE) & 1) != 1);
	for (uint32_t i = 0; i < 4; i++){
		USART_DR = (uint8_t) (data >> 8*i);
		while (((USART_SR >> TXE) & 1) != 1);
	}
	PTR = 0xFF;
	USART_CR1 &= ~(1<<TE);
	toggle();
}

void print(char text[]){
	uint32_t i = 0;
	while ( text[i] != '\0' ){
		transmit((uint8_t)text[i]);
		i++;
	}
}

/* USER CODE END PTD */

void SystemClock_Config(void);

int main(void)
{

  /* MCU Configuration--------------------------------------------------------*/

  /* Reset of all peripherals, Initializes the Flash interface and the Systick. */
  HAL_Init();

  /* Configure the system clock */
  SystemClock_Config();

  /* Initialize all configured peripherals */

  /* Infinite loop */
  /* USER CODE BEGIN WHILE */
  clk();
  gpio();
  init();
  print(" This is amazing! Terminal is up and running. There is a slight problem Though.");
  print(" You see that extra 'u' yes that is the problem.");
//  transmit(0x21);
  while (1)
  {
    /* USER CODE END WHILE */
//	  UART_TX_REG(0x00111111);
//	  transmit(0x21);
  }
}

void SystemClock_Config(void)
{
  RCC_OscInitTypeDef RCC_OscInitStruct = {0};
  RCC_ClkInitTypeDef RCC_ClkInitStruct = {0};

  /** Configure the main internal regulator output voltage
  */
  __HAL_RCC_PWR_CLK_ENABLE();
  __HAL_PWR_VOLTAGESCALING_CONFIG(PWR_REGULATOR_VOLTAGE_SCALE2);

  /** Initializes the RCC Oscillators according to the specified parameters
  * in the RCC_OscInitTypeDef structure.
  */
  RCC_OscInitStruct.OscillatorType = RCC_OSCILLATORTYPE_HSI;
  RCC_OscInitStruct.HSIState = RCC_HSI_ON;
  RCC_OscInitStruct.HSICalibrationValue = RCC_HSICALIBRATION_DEFAULT;
  RCC_OscInitStruct.PLL.PLLState = RCC_PLL_NONE;
  if (HAL_RCC_OscConfig(&RCC_OscInitStruct) != HAL_OK)
  {
    Error_Handler();
  }

  /** Initializes the CPU, AHB and APB buses clocks
  */
  RCC_ClkInitStruct.ClockType = RCC_CLOCKTYPE_HCLK|RCC_CLOCKTYPE_SYSCLK
                              |RCC_CLOCKTYPE_PCLK1|RCC_CLOCKTYPE_PCLK2;
  RCC_ClkInitStruct.SYSCLKSource = RCC_SYSCLKSOURCE_HSI;
  RCC_ClkInitStruct.AHBCLKDivider = RCC_SYSCLK_DIV1;
  RCC_ClkInitStruct.APB1CLKDivider = RCC_HCLK_DIV1;
  RCC_ClkInitStruct.APB2CLKDivider = RCC_HCLK_DIV1;

  if (HAL_RCC_ClockConfig(&RCC_ClkInitStruct, FLASH_LATENCY_0) != HAL_OK)
  {
    Error_Handler();
  }
}

void Error_Handler(void)
{
  __disable_irq();
  while (1)
  {
  }
}
